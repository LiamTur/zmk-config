## boards/shields/lt_1/Kconfig.defconfig
```kconfig
if SHIELD_LT_1_LEFT

config ZMK_KEYBOARD_NAME
    default "litkey"

config ZMK_SPLIT_ROLE_CENTRAL
    default y

endif # SHIELD_LT_1_LEFT

if SHIELD_LT_1_LEFT || SHIELD_LT_1_RIGHT

config ZMK_SPLIT
    default y

endif # SHIELD_LT_1_LEFT || SHIELD_LT_1_RIGHT
```

## boards/shields/lt_1/Kconfig.shield
```kconfig
config SHIELD_LT_1_LEFT
    def_bool $(shields_list_contains,lt_1_left)

config SHIELD_LT_1_RIGHT
    def_bool $(shields_list_contains,lt_1_right)
```
